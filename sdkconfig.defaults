## sdkconfig.defaults
```kconfig
# Disable USB JTAG to free GPIO12/13/14 for W5500 SPI
CONFIG_ESP_CONSOLE_SECONDARY_USB_SERIAL_JTAG=n

# Enable W5500 SPI Ethernet driver in ESP-IDF
CONFIG_ETH_SPI_ETHERNET_W5500=y

# Enable ESP-IDF ETH debug logging
CONFIG_LOG_DEFAULT_LEVEL=3
CONFIG_LOG_MAXIMUM_LEVEL=4
```
